
/*
 * Copyright (c) 2020 The ZMK Contributors
 * Copyright (c) 2023 Innaworks Development Limited, trading as MoErgo
 *
 * SPDX-License-Identifier: MIT
 */

#include <behaviors.dtsi>
/* Include all behaviour includes needed */
#include <dt-bindings/zmk/outputs.h>
#include <dt-bindings/zmk/keys.h>
#include <dt-bindings/zmk/bt.h>
#include <dt-bindings/zmk/rgb.h>

/* Automatically generated layer name #define */
#define LAYER_qwerty 0
#define LAYER_hands_down_vibranium_b 1
#define LAYER_gaming 2
#define LAYER_Lower 3
#define LAYER_Magic 4
#define l_nav 5
#define l_akG 6
#define l_akM 7
#define l_akX 8
#define l_akT 9
#define l_akC 10
#define l_akK 11
#define l_akD 12
#define l_akW 13
#define l_akF 14
#define l_akP 15
#define l_akB 16
#define l_akV 17
#define l_akJ 18
#define l_akA 19
#define l_akU 20
#define l_akE 21
#define l_akO 22
#define l_akI 23
#define l_akDot 24

#define layers_hands_down LAYER_hands_down_vibranium_b

/* To deal with the situation where there is no Lower layer, to keep &lower happy */
#ifndef LAYER_Lower
#define LAYER_Lower 0
#endif

/* Custom Device-tree */

#define my_tapping_term 170
#define my_quick_tapping_term 112
#define my_ak_delay 40

&mt {
    tapping-term-ms = <my_tapping_term>;
};
&sl {
    release-after-ms = <my_tapping_term>;
};
&caps_word {
    continue-list = <UNDER MINUS BSPC DEL LEFT RIGHT>;
};


/* Glove80 system behavior & macros */
/ {
    behaviors {
        // For the "layer" key, it'd nice to be able to use it as either a shift or a toggle.
        // Configure it as a tap dance, so the first tap (or hold) is a &mo and the second tap is a &to
        lower: lower {
            compatible = "zmk,behavior-tap-dance";
            label = "LAYER_TAP_DANCE";
            #binding-cells = <0>;
            tapping-term-ms = <200>;
            bindings = <&mo LAYER_Lower>, <&to LAYER_Lower>;
        };
    };
};

/ {
    macros {
        rgb_ug_status_macro: rgb_ug_status_macro {
            label = "RGB_UG_STATUS";
            compatible = "zmk,behavior-macro";
            #binding-cells = <0>;
            bindings
                = <&rgb_ug RGB_STATUS>;
        };
    };
};


/ {
#ifdef BT_DISC_CMD
    behaviors {
        bt_0: bt_0 {
            compatible = "zmk,behavior-tap-dance";
            label = "BT_0";
            #binding-cells = <0>;
            tapping-term-ms = <200>;
            bindings = <&bt_select_0>, <&bt BT_DISC 0>;
        };
        bt_1: bt_1 {
            compatible = "zmk,behavior-tap-dance";
            label = "BT_1";
            #binding-cells = <0>;
            tapping-term-ms = <200>;
            bindings = <&bt_select_1>, <&bt BT_DISC 1>;
        };
        bt_2: bt_2 {
            compatible = "zmk,behavior-tap-dance";
            label = "BT_2";
            #binding-cells = <0>;
            tapping-term-ms = <200>;
            bindings = <&bt_select_2>, <&bt BT_DISC 2>;
        };
        bt_3: bt_3 {
            compatible = "zmk,behavior-tap-dance";
            label = "BT_3";
            #binding-cells = <0>;
            tapping-term-ms = <200>;
            bindings = <&bt_select_3>, <&bt BT_DISC 3>;
        };
    };
    macros {
        bt_select_0: bt_select_0 {
            label = "BT_SELECT_0";
            compatible = "zmk,behavior-macro";
            #binding-cells = <0>;
            bindings
                = <&out OUT_BLE>,
                  <&bt BT_SEL 0>;
        };
        bt_select_1: bt_select_1 {
            label = "BT_SELECT_1";
            compatible = "zmk,behavior-macro";
            #binding-cells = <0>;
            bindings
                = <&out OUT_BLE>,
                  <&bt BT_SEL 1>;
        };
        bt_select_2: bt_select_2 {
            label = "BT_SELECT_2";
            compatible = "zmk,behavior-macro";
            #binding-cells = <0>;
            bindings
                = <&out OUT_BLE>,
                  <&bt BT_SEL 2>;
        };
        bt_select_3: bt_select_3 {
            label = "BT_SELECT_3";
            compatible = "zmk,behavior-macro";
            #binding-cells = <0>;
            bindings
                = <&out OUT_BLE>,
                  <&bt BT_SEL 3>;
        };
    };
#else
    macros {
        bt_0: bt_0 {
            label = "BT_0";
            compatible = "zmk,behavior-macro";
            #binding-cells = <0>;
            bindings
                = <&out OUT_BLE>,
                  <&bt BT_SEL 0>;
        };
        bt_1: bt_1 {
            label = "BT_1";
            compatible = "zmk,behavior-macro";
            #binding-cells = <0>;
            bindings
                = <&out OUT_BLE>,
                  <&bt BT_SEL 1>;
        };
        bt_2: bt_2 {
            label = "BT_2";
            compatible = "zmk,behavior-macro";
            #binding-cells = <0>;
            bindings
                = <&out OUT_BLE>,
                  <&bt BT_SEL 2>;
        };
        bt_3: bt_3 {
            label = "BT_3";
            compatible = "zmk,behavior-macro";
            #binding-cells = <0>;
            bindings
                = <&out OUT_BLE>,
                  <&bt BT_SEL 3>;
        };
    };
#endif
};

/ {
    behaviors {
        magic: magic {
            compatible = "zmk,behavior-hold-tap";
            label = "MAGIC_HOLD_TAP";
            #binding-cells = <2>;
            flavor = "tap-preferred";
            tapping-term-ms = <200>;
            bindings = <&mo>, <&rgb_ug_status_macro>;
        };
    };
};

/* #define for key positions */
#define POS_LH_T1 52
#define POS_LH_T2 53
#define POS_LH_T3 54
#define POS_LH_T4 69
#define POS_LH_T5 70
#define POS_LH_T6 71
#define POS_LH_C1R2 15
#define POS_LH_C1R3 27
#define POS_LH_C1R4 39
#define POS_LH_C1R5 51
#define POS_LH_C2R1 4
#define POS_LH_C2R2 14
#define POS_LH_C2R3 26
#define POS_LH_C2R4 38
#define POS_LH_C2R5 50
#define POS_LH_C2R6 68
#define POS_LH_C3R1 3
#define POS_LH_C3R2 13
#define POS_LH_C3R3 25
#define POS_LH_C3R4 37
#define POS_LH_C3R5 49
#define POS_LH_C3R6 67
#define POS_LH_C4R1 2
#define POS_LH_C4R2 12
#define POS_LH_C4R3 24
#define POS_LH_C4R4 36
#define POS_LH_C4R5 48
#define POS_LH_C4R6 66
#define POS_LH_C5R1 1
#define POS_LH_C5R2 11
#define POS_LH_C5R3 23
#define POS_LH_C5R4 35
#define POS_LH_C5R5 47
#define POS_LH_C5R6 65
#define POS_LH_C6R1 0
#define POS_LH_C6R2 10
#define POS_LH_C6R3 22
#define POS_LH_C6R4 34
#define POS_LH_C6R5 46
#define POS_LH_C6R6 64
#define POS_RH_T1 57
#define POS_RH_T2 56
#define POS_RH_T3 55
#define POS_RH_T4 74
#define POS_RH_T5 73
#define POS_RH_T6 72
#define POS_RH_C1R2 16
#define POS_RH_C1R3 28
#define POS_RH_C1R4 40
#define POS_RH_C1R5 58
#define POS_RH_C2R1 5
#define POS_RH_C2R2 17
#define POS_RH_C2R3 29
#define POS_RH_C2R4 41
#define POS_RH_C2R5 59
#define POS_RH_C2R6 75
#define POS_RH_C3R1 6
#define POS_RH_C3R2 18
#define POS_RH_C3R3 30
#define POS_RH_C3R4 42
#define POS_RH_C3R5 60
#define POS_RH_C3R6 76
#define POS_RH_C4R1 7
#define POS_RH_C4R2 19
#define POS_RH_C4R3 31
#define POS_RH_C4R4 43
#define POS_RH_C4R5 61
#define POS_RH_C4R6 77
#define POS_RH_C5R1 8
#define POS_RH_C5R2 20
#define POS_RH_C5R3 32
#define POS_RH_C5R4 44
#define POS_RH_C5R5 62
#define POS_RH_C5R6 78
#define POS_RH_C6R1 9
#define POS_RH_C6R2 21
#define POS_RH_C6R3 33
#define POS_RH_C6R4 45
#define POS_RH_C6R5 63
#define POS_RH_C6R6 79

/* Custom Defined Behaviors */
/ {
    /*
*
* Copyright (c) 2021 lowprokb.ca
* SPDX-License-Identifier: MIT
* Copied from https://github.com/moutis/zmk-config and modified by Will Martin for the Glove 80.
* Some actions are omitted, and modifier keys are changed to work with Windows/Linux.
*/

#define LT5 POS_LH_C6R3
#define LT4 POS_LH_C5R3
#define LT3 POS_LH_C4R3
#define LT2 POS_LH_C3R3
#define LT1 POS_LH_C2R3
#define LT0 POS_LH_C1R3

#define LM5 POS_LH_C6R4
#define LM4 POS_LH_C5R4
#define LM3 POS_LH_C4R4
#define LM2 POS_LH_C3R4
#define LM1 POS_LH_C2R4
#define LM0 POS_LH_C1R4

#define LB5 POS_LH_C6R5
#define LB4 POS_LH_C5R5
#define LB3 POS_LH_C4R5
#define LB2 POS_LH_C3R5
#define LB1 POS_LH_C2R5
#define LB0 POS_LH_C1R5

#define RT5 POS_RH_C6R3
#define RT4 POS_RH_C5R3
#define RT3 POS_RH_C4R3
#define RT2 POS_RH_C3R3
#define RT1 POS_RH_C2R3
#define RT0 POS_RH_C1R3

#define RM5 POS_RH_C6R4
#define RM4 POS_RH_C5R4
#define RM3 POS_RH_C4R4
#define RM2 POS_RH_C3R4
#define RM1 POS_RH_C2R4
#define RM0 POS_RH_C1R4

#define RB5 POS_RH_C6R5
#define RB4 POS_RH_C5R5
#define RB3 POS_RH_C4R5
#define RB2 POS_RH_C3R5
#define RB1 POS_RH_C2R5
#define RB0 POS_RH_C1R5

#define LH1 POS_LH_T4
#define LH2 POS_LH_T5
#define LH3 POS_LH_T6
#define RH1 POS_RH_T4
#define RH2 POS_RH_T5
#define RH3 POS_RH_T6

#define KEYS_L LT0 LT1 LT2 LT3 LT4 LM0 LM1 LM2 LM3 LM4 LB0 LB1 LB2 LB3 LB4  // left-hand keys
#define KEYS_R RT0 RT1 RT2 RT3 RT4 RM0 RM1 RM2 RM3 RM4 RB0 RB1 RB2 RB3 RB4  // right-hand keys
#define THUMBS LH3 LH2 LH1 RH1 RH2 RH3                                      // thumb keys

#define COMBO_TIMEOUT 45

#define COMBO_LAYER(NAME, BINDINGS, KEYPOS, LAYERS) \
  combo_##NAME { \
    bindings = <BINDINGS>; \
    key-positions = <KEYPOS>; \
    layers = <LAYERS>; \
    timeout-ms = <COMBO_TIMEOUT >; \
};
#define COMBO_ANY(NAME, BINDINGS, KEYPOS) \
  combo_##NAME { \
    bindings = <BINDINGS>; \
    key-positions = <KEYPOS>; \
    timeout-ms = <COMBO_TIMEOUT >; \
};

combos {
    compatible = "zmk,combos";
    
    COMBO_ANY(appswitch, &AppSwitch, LT1 LT0) // App switch

    //
    // control/modes
    //
    COMBO_LAYER(capsWord, &caps_word, LM2 LM1 RM1 RM2, layers_hands_down) // CAPSWORD
    COMBO_LAYER(capsLock, &kp CAPS, LM3 LM2 RM2 RM3, layers_hands_down) // CAPS LOCK

    //
    // Editing actions (&whitespace)
    //
    COMBO_LAYER(sall, &kp LC(A),      LB4 LB1, layers_hands_down)
    COMBO_LAYER(selword, &m_selword,  LB4 LB0, layers_hands_down)
    COMBO_LAYER(undo, &kp LC(Z),      LB4 LB3, layers_hands_down)
    COMBO_LAYER(redo, &kp LC(Y),  LB4 LB3 LB2, layers_hands_down)
    COMBO_LAYER(copy, &lk LC(X) LC(C), LB3 LB2, layers_hands_down)
    COMBO_LAYER(pste, &lk LC(LS(V)) LC(V), LB2 LB1, layers_hands_down)
    COMBO_LAYER(cloz, &kp LC(W),      LM3 LB3, layers_hands_down)
    COMBO_LAYER(new,  &kp LC(N),      LM2 LB2, layers_hands_down)
    COMBO_LAYER(open, &kp LC(O),      LM1 LB1, layers_hands_down)
    COMBO_LAYER(quit, &kp LC(Q),      LM0 LB0, layers_hands_down)
    COMBO_LAYER(findsel, &b_findsel LC(F) LC(F),  LM4 LB0, layers_hands_down)
    COMBO_LAYER(backspaceWord, &kp LC(BSPC), RT0 RT1, layers_hands_down)

    //
    // type a glyph (tiny board accommodation)
    //
    COMBO_LAYER(typeQ, &lk_qu Q U,      LT3 LT1, layers_hands_down)
    COMBO_LAYER(typeZ, &kp Z,           LM3 LM1, layers_hands_down)
    COMBO_LAYER(typeColn, &lk LS(SEMI) COLON,    RT1 RT3, layers_hands_down)
    COMBO_LAYER(typeSemi, &kp SEMI,     RM0 RM1, layers_hands_down)
    COMBO_LAYER(typeExcl, &kp EXCL,     RT1 RT2, layers_hands_down)
    COMBO_LAYER(typeQues, &kp QMARK,    RT2 RT3, layers_hands_down)
    COMBO_LAYER(typeGrav, &kp GRAVE,    RT3 RT4, layers_hands_down)
    COMBO_LAYER(typeUnder, &kp UNDER,   RB1 RB3, layers_hands_down) // _
    COMBO_LAYER(typeEqual, &lk PRCNT EQUAL,   RB2 RB3, layers_hands_down) // = (percent if held)
    COMBO_LAYER(typeTilde, &kp TILDE,   RB1 RB4, layers_hands_down) // tilde (not dead key)

    //
    // H Digraphs REQUIRE macros (defined earlier) to process
    //
    COMBO_LAYER(sch, &Sch,  LM4  LM3 LM2, layers_hands_down) // Sch
    COMBO_LAYER(tch, &Tch,  LM4  LM3 LM1, layers_hands_down) // Tch
    COMBO_LAYER(th,  &lk_th H T, LM2 LM1, layers_hands_down) // Th/sion
    COMBO_LAYER(ch,  &Ch,        LM3 LM2, layers_hands_down) // Ch
    COMBO_LAYER(wh,  &Wh,        LT3 LT2, layers_hands_down) // Wh
    COMBO_LAYER(sh,  &lk_sh H S, LM4 LM3, layers_hands_down) // Sh/sion
    COMBO_LAYER(gh,  &lk_gh H G, LT2 LT1, layers_hands_down) // Gh/ght
    COMBO_LAYER(ph,  &Ph,        LB3 LB1, layers_hands_down) // Ph
    
    //
    // Pronoun combos REQUIRE macros to process
    //

    COMBO_LAYER(pnI, &typePnI,          RM3 RM4, layers_hands_down) // "I "

    COMBO_LAYER(pnIm, &typePnIm,        RM3 LT2, layers_hands_down) // "I'm "
    COMBO_LAYER(pnIll, &typePnIll,      RM3 LB2, layers_hands_down) // "I'll "
    COMBO_LAYER(pnId, &typePnId,        RM3 LB1, layers_hands_down) // "I'd "
    COMBO_LAYER(pnIve, &typePnIve,      RM3 LB0, layers_hands_down) // "I've "

    COMBO_LAYER(pnYour,  &typePnYour,   RB3 LH1, layers_hands_down) // "Your "
    COMBO_LAYER(pnYoure, &typePnYoure,  RB3 LB3, layers_hands_down) // "You're "
    COMBO_LAYER(pnYoull, &typePnYoull,  RB3 LB2, layers_hands_down) // "You'll "
    COMBO_LAYER(pnYoud, &typePnYoud,    RB3 LB1, layers_hands_down) // "You'd "
    COMBO_LAYER(pnYouve, &typePnYouve,  RB3 LB0, layers_hands_down) // "You've "

    COMBO_LAYER(pnWere, &typePnWere,    LT4 LH1, layers_hands_down) // "We're "
    COMBO_LAYER(pnWell, &typePnWell,    LT4 LT2, layers_hands_down) // "We'll "
    COMBO_LAYER(pnWed, &typePnWed,      LT4 LT1, layers_hands_down) // "We'd "
    COMBO_LAYER(pnWeve, &typePnWeve,    LT4 LT0, layers_hands_down) // "We've "
    
    
};

behaviors {

    skapp: sticky_key_app_switcher {
        compatible = "zmk,behavior-sticky-key";
        label = "SK_APP_SWITCHER";
        #binding-cells = <1>;
        bindings = <&kp>;
        release-after-ms = <900>;
    };

    hm: homerow_mods { // use on either hand
        compatible = "zmk,behavior-hold-tap";
        label = "homerow_mods";
        #binding-cells = <2>;
        tapping-term-ms = <my_tapping_term>;
        quick-tap-ms = <my_quick_tapping_term>;
        flavor = "balanced";
        bindings = <&kp>, <&kp>;
    };
    hmr: homerow_mods_right { // use on right hand to mod left
        compatible = "zmk,behavior-hold-tap";
        label = "homerow_mods";
        #binding-cells = <2>;
        tapping-term-ms = <my_tapping_term>;
        flavor = "balanced";
        bindings = <&kp>, <&kp>;
        hold-trigger-key-positions = <KEYS_L THUMBS>; // left hand allowed
    };
    hml: homerow_mods_left { // use on left hand to mod right
        compatible = "zmk,behavior-hold-tap";
        label = "homerow_mods";
        #binding-cells = <2>;
        tapping-term-ms = <my_tapping_term>;
        flavor = "balanced";
        bindings = <&kp>, <&kp>;
        hold-trigger-key-positions = <KEYS_R THUMBS>; // right hand allowed
    };
    hrm_t: hrm_t {
        compatible = "zmk,behavior-hold-tap";
        label = "hrm_t";
        #binding-cells = <2>;
        tapping-term-ms = <my_tapping_term>;
        flavor = "balanced";
        bindings = <&kp>, <&ak_t>;
        hold-trigger-key-positions = <KEYS_R THUMBS>; // right hand allowed
    };
    hrm_c: hrm_c {
        compatible = "zmk,behavior-hold-tap";
        label = "hrm_c";
        #binding-cells = <2>;
        tapping-term-ms = <my_tapping_term>;
        flavor = "balanced";
        bindings = <&kp>, <&ak_c>;
        hold-trigger-key-positions = <KEYS_R THUMBS>; // right hand allowed
    };
    hrm_a: hrm_a {
        compatible = "zmk,behavior-hold-tap";
        label = "hrm_a";
        #binding-cells = <2>;
        tapping-term-ms = <my_tapping_term>;
        flavor = "balanced";
        bindings = <&kp>, <&ak_a>;
        hold-trigger-key-positions = <KEYS_L THUMBS>; // left hand allowed
    };
    hrm_e: hrm_e {
        compatible = "zmk,behavior-hold-tap";
        label = "hrm_e";
        #binding-cells = <2>;
        tapping-term-ms = <my_tapping_term>;
        flavor = "balanced";
        bindings = <&kp>, <&ak_e>;
        hold-trigger-key-positions = <KEYS_L THUMBS>; // left hand allowed
    };
    hrm_i: hrm_i {
        compatible = "zmk,behavior-hold-tap";
        label = "hrm_i";
        #binding-cells = <2>;
        tapping-term-ms = <my_tapping_term>;
        flavor = "balanced";
        bindings = <&kp>, <&ak_i>;
        hold-trigger-key-positions = <KEYS_L THUMBS>; // left hand allowed
    };

    // Custom shifted pairs
    double_quote: double_quote_and_exclamation {
        compatible = "zmk,behavior-mod-morph";
        #binding-cells = <0>;
        label = "DOUBLE_QUOTE_AND_EXCLAMATION";
        bindings = <&kp DQT>, <&kp EXCL>;
        mods = <(MOD_LSFT|MOD_RSFT)>;
    };
    // Custom hold behaviours
    lk: lk {
        compatible = "zmk,behavior-hold-tap";
        label = "lk";
        #binding-cells = <2>;
        tapping-term-ms = <my_tapping_term>;
        flavor = "tap-preferred";
        bindings = <&kp>, <&kp>;
    };
    b_findsel: b_findsel {
        compatible = "zmk,behavior-hold-tap";
        label = "b_findsel";
        #binding-cells = <2>;
        tapping-term-ms = <my_tapping_term>;
        flavor = "tap-preferred";
        bindings = <&m_findsel>, <&kp>;
    };
    
    lk_qu: lk_qu {
        compatible = "zmk,behavior-hold-tap";
        label = "lk_qu";
        #binding-cells = <2>;
        tapping-term-ms = <my_tapping_term>;
        flavor = "tap-preferred";
        bindings = <&kp>, <&Qu>;
    };
    lk_th: lk_th { // Th on tap, tion on "linger"
        compatible = "zmk,behavior-hold-tap";
        label = "lk_th";
        #binding-cells = <2>;
        tapping-term-ms = <my_tapping_term>;
        quick-tap-ms = <90>;
        //            global-quick-tap;
        flavor = "tap-preferred";
        bindings = <&tion>, <&Th>;
    };
    lk_sh: lk_sh { // Sh on tap, sion on "linger"
        compatible = "zmk,behavior-hold-tap";
        label = "lk_sh";
        #binding-cells = <2>;
        tapping-term-ms = <my_tapping_term>;
        quick-tap-ms = <90>;
        //            global-quick-tap;
        flavor = "tap-preferred";
        bindings = <&sion>, <&Sh>;
    };
    lk_gh: lk_gh { // Gh on tap, Ght on "linger"
        compatible = "zmk,behavior-hold-tap";
        label = "lk_gh";
        #binding-cells = <2>;
        tapping-term-ms = <my_tapping_term>;
        quick-tap-ms = <90>;
        //            global-quick-tap;
        flavor = "tap-preferred";
        bindings = <&ght>, <&Gh>;
    };    
    lk_quote: lk_quote { // " on tap, “” on "linger" (curly quotes)
        compatible = "zmk,behavior-hold-tap";
        label = "lk_quote";
        #binding-cells = <2>;
        tapping-term-ms = <my_tapping_term>;
        flavor = "tap-preferred";
        bindings = <&pairDquo>, <&kp>;
    };
    lk_par: lk_par { // ( on tap, () on "linger"
        compatible = "zmk,behavior-hold-tap";
        label = "lk_par";
        #binding-cells = <2>;
        tapping-term-ms = <my_tapping_term>;
        flavor = "tap-preferred";
        bindings = <&pairPar>, <&kp>;
    };
    lk_bkt: lk_bkt { // [ on tap, [] on "linger"
        compatible = "zmk,behavior-hold-tap";
        label = "lk_bkt";
        #binding-cells = <2>;
        tapping-term-ms = <my_tapping_term>;
        flavor = "tap-preferred";
        bindings = <&pairBkt>, <&kp>;
    };
    lk_brc: lk_brc { // { on tap, {} on "linger"
        compatible = "zmk,behavior-hold-tap";
        label = "lk_brc";
        #binding-cells = <2>;
        tapping-term-ms = <my_tapping_term>;
        flavor = "tap-preferred";
        bindings = <&pairBrc>, <&kp>;
    };
    lk_ltgt: lk_ltgt { // < on tap, <|> on "linger"
        compatible = "zmk,behavior-hold-tap";
        label = "lk_ltgt";
        #binding-cells = <2>;
        tapping-term-ms = <my_tapping_term>;
        flavor = "tap-preferred";
        bindings = <&pairLtGt>, <&kp>;
    };

    CmmaSemi: CmmaSemi {
        compatible = "zmk,behavior-mod-morph";
        label = "comma_semi";
        #binding-cells = <0>;
        bindings = <&kp CMMA>, <&typeSemi>;
        mods = <(MOD_LSFT|MOD_RSFT)>;
    };
    DotColn: DotColn {
        compatible = "zmk,behavior-mod-morph";
        label = "DotColn";
        #binding-cells = <0>;
        bindings = <&dot_ak>, <&kp COLON>;
        mods = <(MOD_LSFT|MOD_RSFT)>;
    };
    SlshStar: SlshStar {
        compatible = "zmk,behavior-mod-morph";
        label = "SlshStar";
        #binding-cells = <0>;
        bindings = <&kp FSLH>, <&kp STAR>;
        mods = <(MOD_LSFT|MOD_RSFT)>;
    };
    HashDllr: HashDllr {
        compatible = "zmk,behavior-mod-morph";
        label = "HashDllr";
        #binding-cells = <0>;
        bindings = <&kp HASH>, <&kp DLLR>;
        mods = <(MOD_LSFT|MOD_RSFT)>;
    };
    MinusPlus: MinusPlus {
        compatible = "zmk,behavior-mod-morph";
        label = "MinusPlus";
        #binding-cells = <0>;
        bindings = <&kp MINUS>, <&kp PLUS>;
        mods = <(MOD_LSFT|MOD_RSFT)>;
    };
    DqtLbkt: DqtLbkt {
        compatible = "zmk,behavior-mod-morph";
        label = "DqtLbkt";
        #binding-cells = <0>;
        bindings = <&kp DQT>, <&kp LBKT>;
        mods = <(MOD_LALT|MOD_RALT)>;
    };
    DqtRbkt: DqtRbkt {
        compatible = "zmk,behavior-mod-morph";
        label = "DqtRbkt";
        #binding-cells = <0>;
        bindings = <&kp DQT>, <&kp RBKT>;
        mods = <(MOD_LALT|MOD_RALT)>;
    };
    SqtLbkt: SqtLbkt {
        compatible = "zmk,behavior-mod-morph";
        label = "SqtLbkt";
        #binding-cells = <0>;
        bindings = <&kp SQT>, <&kp LBKT>;
        mods = <(MOD_LALT|MOD_RALT)>;
    };
    SqtRbkt: SqtRbkt {
        compatible = "zmk,behavior-mod-morph";
        label = "SqtRbkt";
        #binding-cells = <0>;
        bindings = <&kp SQT>, <&kp RBKT>;
        mods = <(MOD_LALT|MOD_RALT)>;
    };
    BspcDel: Bspc_Del {
        compatible = "zmk,behavior-mod-morph";
        label = "Bspc_Del";
        #binding-cells = <0>;
        bindings = <&kp BSPC>, <&kp DEL>;
        mods = <(MOD_LSFT|MOD_RSFT)>;
    };
    
    LparLt: LparLt {
        compatible = "zmk,behavior-mod-morph";
        label = "LparLt";
        #binding-cells = <0>;
        bindings = <&kp LT>, <&kp LPAR>;
        mods = <(MOD_LSFT|MOD_RSFT)>;
    };
    RparGt: RparGt {
        compatible = "zmk,behavior-mod-morph";
        label = "RparGt";
        #binding-cells = <0>;
        bindings = <&kp GT>, <&kp RPAR>;
        mods = <(MOD_LSFT|MOD_RSFT)>;
    };
};

macros {
    ZMK_MACRO(AppSwitch,
        wait-ms = <50>;
        tap-ms = <20>;
        bindings =
            <&macro_press &kp RGUI>    // leave GUI down to keep menu up
          , <&macro_tap &kp TAB>       // (use press for repeat)
          , <&tog l_nav>               // to navigate the app menu
          , <&macro_pause_for_release> // hold to keep menu up or for repeat ...
          , <&tog l_nav>               // done navigating
          , <&macro_tap &skapp LGUI>   // release other GUI after a timeout
          , <&macro_release &kp RGUI>  // release the previous hold
          ;
    )
    ZMK_MACRO(S_AppSwitch,
        wait-ms = <50>;
        tap-ms = <20>;
        bindings =
            <&macro_press &sk RGUI> // leave GUI down to keep menu up
          , <&macro_press &kp LSHFT> //
          , <&macro_tap &kp TAB> // just tap for no repeat
          , <&macro_pause_for_release> // hold for repeat ...
          , <&macro_release &kp LSHFT> //
          , <&macro_tap &skapp LGUI> // release other GUI after a timeout
          , <&macro_release &sk RGUI> // now release the previous hold
          ;
    )

    ZMK_MACRO(Qu,
        wait-ms = <10>;
        tap-ms = <10>;
        bindings = <&macro_tap &kp Q>
            , <&macro_release &kp LSHFT>
            , <&macro_release &kp RSHFT>
            , <&macro_tap &kp U>
            ;
    )
    
    pairDquo: pairDquo {
        label = "pairDquo";
        compatible = "zmk,behavior-macro";
        #binding-cells = <0>;
        wait-ms = <50>; // need to slow this down for some systems.
        bindings = <&kp LA(LBKT) &kp LS(LA(LBKT)) &kp LEFT>
                ;
        };
    pairLtGt: pairLtGt {
        label = "pairLtGt";
        compatible = "zmk,behavior-macro";
        #binding-cells = <0>;
        wait-ms = <50>; // need to slow this down for some systems.
        bindings = <&kp LT &kp GT &kp LEFT>
                ;
        };
    pairPar: pairPar {
        label = "pairPar";
        compatible = "zmk,behavior-macro";
        #binding-cells = <0>;
        wait-ms = <50>; // need to slow this down for some systems.
        bindings = <&kp LPAR &kp RPAR &kp LEFT>
                ;
        };
    pairBrc: pairBrc {
        label = "pairBrc";
        compatible = "zmk,behavior-macro";
        #binding-cells = <0>;
        wait-ms = <50>; // need to slow this down for some systems.
        bindings = <&kp LBRC &kp RBRC &kp LEFT>
                ;
        };
    pairBkt: pairBkt {
        label = "pairBkt";
        compatible = "zmk,behavior-macro";
        #binding-cells = <0>;
        wait-ms = <50>; // need to slow this down for some systems.
        bindings = <&kp LBKT &kp RBKT &kp LEFT>
                ;
        };
    dot_ak: dot_ak {
        label = "dot_ak";
        compatible = "zmk,behavior-macro";
        #binding-cells = <0>;
        wait-ms = <50>; // need to slow this down for some systems.
        bindings = <&macro_tap &kp DOT>
                , <&sl l_akDot>;
        };
    dotcom: dotcom {
        label = "dotcom";
        compatible = "zmk,behavior-macro";
        #binding-cells = <0>;
        wait-ms = <50>; // need to slow this down for some systems.
        bindings = <&kp C &kp O &kp M>
                ;
        };
    dotcouk: dotcouk {
        label = "dotcouk";
        compatible = "zmk,behavior-macro";
        #binding-cells = <0>;
        wait-ms = <50>; // need to slow this down for some systems.
        bindings = <&kp C &kp O &kp DOT &kp U &kp K>
                ;
        };

    m_selword: m_selword {
        label = "m_select word";
        compatible = "zmk,behavior-macro";
        #binding-cells = <0>;
        wait-ms = <10>;
        tap-ms = <10>;
        bindings = <&macro_tap &kp LC(LEFT)>
                , <&macro_tap &kp LS(LC(RIGHT))>
            ;
    };

    m_findsel: m_findsel {
        label = "Find Selection";
        compatible = "zmk,behavior-macro";
        #binding-cells = <0>;
        wait-ms = <10>;
        tap-ms = <10>;
         bindings = <&macro_tap &kp LC(C)>
                , <&macro_tap &kp LC(F)>
                , <&macro_tap &kp LC(V)>
                , <&macro_tap &kp RETURN>
                , <&macro_tap &kp LC(G)>
            ;
    };
    
    Sch: Sch {
        label = "Sch";
        compatible = "zmk,behavior-macro";
        #binding-cells = <0>;
        wait-ms = <10>;
        tap-ms = <10>;
        bindings = <&macro_tap &kp S>
                , <&macro_release &kp LSHFT>
                , <&macro_release &kp RSHFT>
                , <&macro_tap &kp C &kp H>
            ;
    };
    Tch: Tch {
        label = "Tch";
        compatible = "zmk,behavior-macro";
        #binding-cells = <0>;
        wait-ms = <10>;
        tap-ms = <10>;
        bindings = <&macro_tap &kp T>
                , <&macro_release &kp LSHFT>
                , <&macro_release &kp RSHFT>
                , <&macro_tap &kp C &kp H>
            ;
    };
    
    ZMK_MACRO(typeSemi,
        wait-ms = <10>;
        tap-ms = <10>;
        bindings = <&macro_release &kp LSHFT>
            , <&macro_tap &kp SEMICOLON>
            ;
    )
    
    Th: Th {
        label = "Th";
        compatible = "zmk,behavior-macro";
        #binding-cells = <0>;
        wait-ms = <10>;
        tap-ms = <10>;
        bindings = <&macro_tap &kp T>
            , <&macro_release &kp LSHFT>
            , <&macro_release &kp RSHFT>
            , <&macro_tap &kp H>
            ;
    };
    ZMK_MACRO(tion,
        wait-ms = <10>;
        tap-ms = <10>;
        bindings = <&kp T &kp I &kp O &kp N>
                ;
    )
    ZMK_MACRO(Ch,
        wait-ms = <10>;
        tap-ms = <10>;
        bindings = <&macro_tap &kp C>
                , <&macro_release &kp LSHFT>
                , <&macro_release &kp RSHFT>
                , <&macro_tap &kp H>
                ;
        )
    ZMK_MACRO(Wh,
        wait-ms = <10>;
        tap-ms = <10>;
        bindings = <&macro_tap &kp W>
                , <&macro_release &kp LSHFT>
                , <&macro_release &kp RSHFT>
                , <&macro_tap &kp H>
                ;
        )
    ZMK_MACRO(Sh,
        wait-ms = <10>;
        tap-ms = <10>;
        bindings = <&macro_tap &kp S>
                , <&macro_release &kp LSHFT>
                , <&macro_release &kp RSHFT>
                , <&macro_tap &kp H>
                ;
        )
    ZMK_MACRO(sion,
        wait-ms = <10>;
        tap-ms = <10>;
        bindings = <&kp S &kp I &kp O &kp N>
                ;
        )
    ZMK_MACRO(Gh,
            wait-ms = <10>;
            tap-ms = <10>;
        bindings = <&macro_tap &kp G>
                , <&macro_release &kp LSHFT>
                , <&macro_release &kp RSHFT>
                , <&macro_tap &kp H>
                ;
        )
    ZMK_MACRO(ght,
            wait-ms = <10>;
            tap-ms = <10>;
        bindings = <&kp G &kp H &kp T>
                ;
        )
    ZMK_MACRO(Ph,
            wait-ms = <10>;
            tap-ms = <10>;
        bindings = <&macro_tap &kp P>
                , <&macro_release &kp LSHFT>
                , <&macro_release &kp RSHFT>
                , <&macro_tap &kp H>
                ;
        )
        
    // Pronouns
    typePnI: pnI {
        label = "pnI";
        compatible = "zmk,behavior-macro";
        #binding-cells = <0>;
        wait-ms = <10>;
        tap-ms = <10>;
        bindings = <&macro_tap &kp LS(I)>
                , <&macro_tap &kp SPACE>
            ;
    };
    typePnIm: pnIm {
        label = "pnIM";
        compatible = "zmk,behavior-macro";
        #binding-cells = <0>;
        wait-ms = <10>;
        tap-ms = <10>;
        bindings = <&macro_tap &kp LS(I)>
                , <&macro_release &kp LSHFT>
                , <&macro_release &kp RSHFT>
                , <&macro_tap &kp APOS &kp M &kp SPACE>
            ;
    };
    typePnId: pnId {
        label = "pnID";
        compatible = "zmk,behavior-macro";
        #binding-cells = <0>;
        wait-ms = <10>;
        tap-ms = <10>;
        bindings = <&macro_tap &kp LS(I)>
                , <&macro_release &kp LSHFT>
                , <&macro_release &kp RSHFT>
                , <&macro_tap &kp APOS &kp D &kp SPACE>
            ;
    };
    typePnIll: pnIll {
        label = "pnIL";
        compatible = "zmk,behavior-macro";
        #binding-cells = <0>;
        wait-ms = <10>;
        tap-ms = <10>;
        bindings = <&macro_tap &kp LS(I)>
                , <&macro_release &kp LSHFT>
                , <&macro_release &kp RSHFT>
                , <&macro_tap &kp APOS &kp L &kp L &kp SPACE>
            ;
    };
    typePnIve: pnIve {
        label = "pnIVE";
        compatible = "zmk,behavior-macro";
        #binding-cells = <0>;
        wait-ms = <10>;
        tap-ms = <10>;
        bindings = <&macro_tap &kp LS(I)>
                , <&macro_release &kp LSHFT>
                , <&macro_release &kp RSHFT>
                , <&macro_tap &kp APOS &kp V &kp E &kp SPACE>
            ;
    };
    // YOU
    typePnYour: pnYour {
        label = "pnYour";
        compatible = "zmk,behavior-macro";
        #binding-cells = <0>;
        wait-ms = <10>;
        tap-ms = <10>;
        bindings = <&macro_tap &kp Y>
                , <&macro_release &kp LSHFT>
                , <&macro_release &kp RSHFT>
                , <&macro_tap &kp O &kp U &kp R &kp SPACE>
            ;
    };
    typePnYoure: pnYoure {
        label = "pnYoure";
        compatible = "zmk,behavior-macro";
        #binding-cells = <0>;
        wait-ms = <10>;
        tap-ms = <10>;
        bindings = <&macro_tap &kp Y>
                , <&macro_release &kp LSHFT>
                , <&macro_release &kp RSHFT>
                , <&macro_tap &kp O &kp U &kp APOS &kp R &kp E &kp SPACE>
            ;
    };
    typePnYoud: pnYoud {
        label = "pnYou'd";
        compatible = "zmk,behavior-macro";
        #binding-cells = <0>;
        wait-ms = <10>;
        tap-ms = <10>;
        bindings = <&macro_tap &kp Y>
                , <&macro_release &kp LSHFT>
                , <&macro_release &kp RSHFT>
                , <&macro_tap &kp O &kp U &kp APOS &kp D &kp SPACE>
            ;
    };
    typePnYoull: pnYoull {
        label = "pnYou'll";
        compatible = "zmk,behavior-macro";
        #binding-cells = <0>;
        wait-ms = <10>;
        tap-ms = <10>;
        bindings = <&macro_tap &kp Y>
                , <&macro_release &kp LSHFT>
                , <&macro_release &kp RSHFT>
                , <&macro_tap &kp O &kp U &kp APOS &kp L &kp L &kp SPACE>
            ;
    };
    typePnYouve: pnYouve {
        label = "pnYou've";
        compatible = "zmk,behavior-macro";
        #binding-cells = <0>;
        wait-ms = <10>;
        tap-ms = <10>;
        bindings = <&macro_tap &kp Y>
                , <&macro_release &kp LSHFT>
                , <&macro_release &kp RSHFT>
                , <&macro_tap &kp O &kp U &kp APOS &kp V &kp E &kp SPACE>
            ;
    };
    // WE
    typePnWere: pnWere {
        label = "pnWere";
        compatible = "zmk,behavior-macro";
        #binding-cells = <0>;
        wait-ms = <10>;
        tap-ms = <10>;
        bindings = <&macro_tap &kp W>
                , <&macro_release &kp LSHFT>
                , <&macro_release &kp RSHFT>
                , <&macro_tap &kp E &kp APOS &kp R &kp E &kp SPACE>
            ;
    };
    typePnWed: pnWed {
        label = "pnWe'd";
        compatible = "zmk,behavior-macro";
        #binding-cells = <0>;
        wait-ms = <10>;
        tap-ms = <10>;
        bindings = <&macro_tap &kp W>
                , <&macro_release &kp LSHFT>
                , <&macro_release &kp RSHFT>
                , <&macro_tap &kp E &kp APOS &kp D &kp SPACE>
            ;
    };
    typePnWell: pnWell {
        label = "pnWe'll";
        compatible = "zmk,behavior-macro";
        #binding-cells = <0>;
        wait-ms = <10>;
        tap-ms = <10>;
        bindings = <&macro_tap &kp W>
                , <&macro_release &kp LSHFT>
                , <&macro_release &kp RSHFT>
                , <&macro_tap &kp E &kp APOS &kp L &kp L &kp SPACE>
            ;
    };
    typePnWeve: pnWeve {
        label = "pnWe've";
        compatible = "zmk,behavior-macro";
        #binding-cells = <0>;
        wait-ms = <10>;
        tap-ms = <10>;
        bindings = <&macro_tap &kp W>
                , <&macro_release &kp LSHFT>
                , <&macro_release &kp RSHFT>
                , <&macro_tap &kp E &kp APOS &kp V &kp E &kp SPACE>
            ;
    };

    // moutis digraph macros
    ZMK_MACRO(ak_g,
            wait-ms = <10>;
            tap-ms = <10>;
        bindings = <&macro_tap &kp G>
                , <&sl l_akG>;
        )
    ZMK_MACRO(ak_d,
            wait-ms = <10>;
            tap-ms = <10>;
        bindings = <&macro_tap &kp D>
                , <&sl l_akD>;
        )
    ZMK_MACRO(ak_x,
            wait-ms = <10>;
            tap-ms = <10>;
        bindings = <&macro_tap &kp X>
                , <&sl l_akX>;
        )
    ZMK_MACRO(ak_xp,
            wait-ms = <10>;
            tap-ms = <10>;
        bindings = <&macro_tap &kp P>
                , <&sl l_akX>;
        )
    ZMK_MACRO(ak_m,
            wait-ms = <10>;
            tap-ms = <10>;
        bindings = <&macro_tap &kp M>
                , <&sl l_akM>;
        )
    ZMK_MACRO(ak_lg,
            wait-ms = <10>;
            tap-ms = <10>;
        bindings = <&kp BSPC &kp L &kp G>;
        )
    ZMK_MACRO(ak_lm,
            wait-ms = <10>;
            tap-ms = <10>;
        bindings = <&kp BSPC &kp L &kp M>
                    , <&sl l_akM>;
        )
    ZMK_MACRO(ak_lk,
            wait-ms = <10>;
            tap-ms = <10>;
        bindings = <&kp BSPC &kp L &kp K>;
        )
    ZMK_MACRO(ak_k,
            wait-ms = <10>;
            tap-ms = <10>;
        bindings = <&macro_tap &kp K>
                , <&sl l_akK>;
        )
    ZMK_MACRO(ak_w,
            wait-ms = <10>;
            tap-ms = <10>;
        bindings = <&macro_tap &kp W>
                , <&sl l_akW>;
        )
    ZMK_MACRO(ak_b,
            wait-ms = <10>;
            tap-ms = <10>;
        bindings = <&macro_tap &kp B>
                , <&sl l_akB>;
        )
    ZMK_MACRO(ak_sb,
            wait-ms = <10>;
            tap-ms = <10>;
        bindings = <&kp BSPC &kp S &kp B>;
        )
    ZMK_MACRO(ak_p,
            wait-ms = <10>;
            tap-ms = <10>;
        bindings = <&macro_tap &kp P>
                , <&sl l_akP>;
        )
    ZMK_MACRO(ak_sp,
            wait-ms = <10>;
            tap-ms = <10>;
        bindings = <&kp BSPC &kp S &kp P>;
        )
    ZMK_MACRO(ak_f,
            wait-ms = <10>;
            tap-ms = <10>;
        bindings = <&macro_tap &kp F>
                , <&sl l_akF>;
        )
    ZMK_MACRO(ak_sf,
            wait-ms = <10>;
            tap-ms = <10>;
        bindings = <&kp BSPC &kp S &kp F>;
        )
    ZMK_MACRO(ak_v,
            wait-ms = <10>;
            tap-ms = <10>;
        bindings = <&macro_tap &kp V>
                , <&sl l_akV>;
        )

    ZMK_MACRO(ak_t,
            wait-ms = <10>;
            tap-ms = <10>;
        bindings = <&macro_tap &kp T>
                , <&sl l_akT>;
        )
    ZMK_MACRO(ak_ck,
            wait-ms = <10>;
            tap-ms = <10>;
        bindings = <&kp BSPC &kp C &kp K>;
        )
    ZMK_MACRO(ak_c,
            wait-ms = <10>;
            tap-ms = <10>;
        bindings = <&macro_tap &kp C>
                , <&sl l_akC>;
        )
    ZMK_MACRO(ak_a,
            wait-ms = <10>;
            tap-ms = <10>;
        bindings = <&macro_tap &kp A>
                , <&sl l_akA>;
        )
    ZMK_MACRO(ak_u,
            wait-ms = <10>;
            tap-ms = <10>;
        bindings = <&macro_tap &kp U>
                , <&sl l_akU>;
        )
    ZMK_MACRO(ak_e,
            wait-ms = <10>;
            tap-ms = <10>;
        bindings = <&kp E &sl l_akE>;
        )
    ZMK_MACRO(ak_o,
            wait-ms = <10>;
            tap-ms = <10>;
        bindings = <&kp O &sl l_akO>;
        )
    ZMK_MACRO(ak_i,
            wait-ms = <10>;
            tap-ms = <10>;
        bindings = <&kp I &sl l_akI>;
        )
    ZMK_MACRO(ak_y,
            wait-ms = <10>;
            tap-ms = <10>;
        bindings = <&kp Y &sl l_akJ>;
        )
    ZMK_MACRO(ak_j,
            wait-ms = <10>;
            tap-ms = <10>;
        bindings = <&kp J &sl l_akJ>;
        )
    ZMK_MACRO(l_j_o,
            wait-ms = <10>;
            tap-ms = <10>;
        bindings = <&kp O &sl l_akJ>;
        )
    ZMK_MACRO(l_j_y,
            wait-ms = <10>;
            tap-ms = <10>;
        bindings = <&kp Y &sl l_akJ>;
        )
    ZMK_MACRO(l_j_g,
            wait-ms = <10>;
            tap-ms = <10>;
        bindings = <&kp P &kp G>;
        )
};
};

/* Automatically generated macro definitions */
/ {
    macros {
    
    };
};

/ {
    keymap {
        compatible = "zmk,keymap";


        layer_qwerty {
            bindings = <
               &kp F1    &kp F2     &kp F3     &kp F4   &kp F5                                                                                &kp F6     &kp F7    &kp F8    &kp F9               &kp F10
            &kp EQUAL    &kp N1     &kp N2     &kp N3   &kp N4  &kp N5                                                               &kp N6   &kp N7     &kp N8    &kp N9    &kp N0              &kp BSLH
              &kp ESC     &kp Q      &kp W      &kp E    &kp R   &kp T                                                                &kp Y    &kp U      &kp I     &kp O     &kp P             &kp MINUS
              &kp TAB     &kp A      &kp S      &kp D    &kp F   &kp G                                                                &kp H    &kp J      &kp K     &kp L  &kp SEMI               &kp SQT
            &kp LSHFT     &kp Z      &kp X      &kp C    &kp V   &kp B    &kp UP  &kp DOWN    &lower  &kp LGUI  &kp LEFT  &kp RIGHT   &kp N    &kp M  &kp COMMA   &kp DOT  &kp FSLH             &kp RSHFT
 &magic LAYER_Magic 0  &kp HOME  &kp PG_UP  &kp PG_DN  &kp END          &kp BSPC   &kp DEL  &kp LGUI   &kp TAB   &kp RET  &kp SPACE          &LparLt   &kp LBKT  &kp RBKT   &RparGt  &magic LAYER_Magic 0
            >;
        };

        layer_hands_down_vibranium_b {
            bindings = <
    &trans    &trans      &trans      &trans        &trans                                                                                        &trans          &trans          &trans        &trans      &trans
    &trans    &trans      &trans      &trans        &trans          &trans                                                            &trans      &trans          &trans          &trans        &trans      &trans
    &kp ESC   &ak_x       &ak_w       &ak_m         &ak_g           &ak_j                                                             &HashDllr   &DotColn        &SlshStar       &DqtLbkt      &SqtRbkt    &kp BSPC
    &kp TAB   &hml LGUI S &hml LALT C &hml LCTRL N  &hrm_t LSHFT T  &ak_k                                                             &CmmaSemi   &hrm_a RSHFT A  &hrm_e RCTRL E  &hrm_i RALT I &hmr RGUI H &trans
    &kp LSHFT &ak_b       &ak_p       &kp L         &ak_d           &ak_v     &trans    &trans    &trans  &trans   &trans   &trans    &MinusPlus  &ak_u           &ak_o           &ak_y         &kp F       &kp RSHFT
    &trans    &trans      &trans      &trans        &trans                    &kp R     &BspcDel  &trans  &kp TAB  &kp RET  &kp SPACE             &trans          &trans          &trans        &trans      &trans
            >;
        };

        layer_gaming {
            bindings = <
               &kp F1     &kp F2     &kp F3  &kp F4    &kp F5                                                                                  &kp F6     &kp F7    &kp F8    &kp F9          &kp F10
                &kp N     &kp N1     &kp N2  &kp N3    &kp N4  &kp N5                                                                  &kp N6  &kp N7     &kp N8    &kp N9    &kp N0        &kp MINUS
              &kp TAB   &kp LEFT  &kp RIGHT  &kp UP  &kp DOWN   &kp M                                                                   &kp Y   &kp U      &kp I     &kp O     &kp P  &kp NON_US_BSLH
              &kp ESC      &kp A      &kp Q   &kp W     &kp E   &kp R                                                                   &kp H   &kp J      &kp K     &kp L  &kp SEMI          &kp SQT
            &kp GRAVE  &kp LSHFT      &kp A   &kp S     &kp D   &kp F  &kp LSHFT  &kp LCTRL    &lower  &kp LGUI  &kp RCTRL  &kp RSHFT   &kp N   &kp M  &kp COMMA   &kp DOT  &kp FSLH        &kp PG_UP
 &magic LAYER_Magic 0  &kp LCTRL      &kp Z   &kp X     &kp C          &kp SPACE    &kp DEL  &kp LALT  &kp RALT    &kp RET  &kp SPACE          &kp UP   &kp DOWN  &kp LBKT  &kp RBKT        &kp PG_DN
            >;
        };

        layer_Lower {
            bindings = <
         &kp C_BRI_DN  &kp C_BRI_UP      &kp C_PREV      &kp C_NEXT         &kp C_PP                                                                                    &kp C_MUTE  &kp C_VOL_DN  &kp C_VOL_UP            &none  &kp PAUSE_BREAK
               &trans         &none           &none           &none            &none   &kp HOME                                                   &kp LEFT_PARENTHESIS  &kp KP_NUM  &kp KP_EQUAL  &kp KP_SLASH  &kp KP_MULTIPLY  &kp PRINTSCREEN
               &trans         &none           &none    &kp UP_ARROW            &none    &kp END                                                  &kp RIGHT_PARENTHESIS   &kp KP_N7     &kp KP_N8     &kp KP_N9     &kp KP_MINUS   &kp SCROLLLOCK
           &caps_word         &none  &kp LEFT_ARROW  &kp DOWN_ARROW  &kp RIGHT_ARROW  &kp PG_UP                                                            &kp PERCENT   &kp KP_N4     &kp KP_N5     &kp KP_N6      &kp KP_PLUS            &none
               &trans     &kp K_APP           &none         &kp F11          &kp F12  &kp PG_DN  &trans  &trans   &to 0  &trans  &trans  &trans              &kp COMMA   &kp KP_N1     &kp KP_N2     &kp KP_N3     &kp KP_ENTER           &trans
 &magic LAYER_Magic 0      &kp CAPS         &kp INS         &kp F11          &kp F12             &trans  &trans  &trans  &trans  &trans  &trans                          &kp KP_N0     &kp KP_N0    &kp KP_DOT     &kp KP_ENTER           &trans
            >;
        };

        layer_Magic {
            bindings = <
  &bt BT_CLR            &none            &none            &none            &none                                                                                     &none      &none     &none     &none  &bt BT_CLR_ALL
       &to 0            &to 1            &to 2            &to 3            &to 4            &none                                                         &none      &none      &none     &none     &to 5           &none
       &none  &rgb_ug RGB_SPI  &rgb_ug RGB_SAI  &rgb_ug RGB_HUI  &rgb_ug RGB_BRI  &rgb_ug RGB_TOG                                                         &none      &none      &none     &none     &none           &none
 &bootloader  &rgb_ug RGB_SPD  &rgb_ug RGB_SAD  &rgb_ug RGB_HUD  &rgb_ug RGB_BRD  &rgb_ug RGB_EFF                                                         &none      &none      &none     &none     &none     &bootloader
  &sys_reset            &none            &none            &none            &none            &none   &bt_2   &bt_3         &none   &none   &none   &none   &none      &none      &none     &none     &none      &sys_reset
       &none         &sk LGUI         &sk LALT        &sk LCTRL        &sk LSHFT                    &bt_0   &bt_1  &out OUT_USB   &none   &none   &none          &sk RSHFT  &sk RCTRL  &sk RALT  &sk RGUI           &none
            >;
        };

//                                     shorcuts & Navigation
//╭────────────────────────────────────────────╮ ╭──────────────────────────────────────────╮
//|  close |   quit  |       |       |   ESC   | |       |  HOME  |   UP   |  PG_UP |       |
//|   ctrl |   alt   |  gui  |  shft |   Find  | | Lword |  LEFT  |  DOWN  |   RGT  | Rword |
//|  undo  |   cut   |  copy |  pste | findAgn | |       |   END  |        |  PG_DN |       |
//╰──────────────────╮       | dwdlt |  dwdrt  | |  back |  fwd   |        ╭────────────────╯
//                   ╰─────────────────────────╯ ╰─────────────────────────╯
        l_nav {
            bindings = <
  &trans  &trans    &trans    &trans         &trans                                                                                                               &trans   &trans     &trans    &trans        &trans
  &trans  &trans    &trans    &trans         &trans             &trans                                                                              &trans        &trans   &trans     &trans    &trans        &trans
  &none   &kp LC(W) &kp LC(Q) &none          &none              &kp ESC                                                                             &kp LC(EQUAL) &kp HOME &kp UP     &kp PG_UP &none         &none
  &none   &kp LGUI  &kp LALT  &kp LCTRL      &kp LSHFT          &kp LC(F)                                                                           &kp LC(LEFT)  &kp LEFT &kp DOWN   &kp RIGHT &kp LC(RIGHT) &none
  &none   &kp LC(Z) &kp LC(X) &kp LC(C)      &kp LC(V)          &kp LC(G)   &none         &none         &none   &none   &none         &none         &kp LC(MINUS) &kp END  &kp LC(N0) &kp PG_DN &none         &none
  &trans  &trans    &trans    &trans         &trans                         &AppSwitch    &S_AppSwitch  &none   &none   &kp LA(LEFT)  &kp LA(RIGHT)               &trans   &trans     &trans    &trans        &trans
            >;
        };

        l_akG {
            bindings = <
 &trans  &trans  &trans  &trans  &trans                                                                  &trans   &trans    &trans  &trans  &trans
 &trans  &kp T   &kp D   &kp L   &trans  &trans                                                  &trans  &trans   &trans    &trans  &trans  &trans
 &trans  &trans  &trans  &trans  &trans  &ak_lk                                                  &trans  &trans   &trans    &trans  &trans  &trans
 &trans  &trans  &trans  &trans  &trans  &trans                                                  &trans  &trans   &trans    &trans  &trans  &trans
 &trans  &trans  &trans  &trans  &trans  &trans  &trans  &trans  &trans  &trans  &trans  &trans  &trans  &trans   &trans    &trans  &trans  &trans
 &trans  &trans  &trans  &trans  &trans          &trans  &trans  &trans  &trans  &trans  &trans          &trans   &trans    &trans  &trans  &trans
            >;
        };

        l_akM {
            bindings = <
 &trans  &trans  &trans  &trans  &trans                                                                  &trans   &trans    &trans  &trans  &trans
 &trans  &trans  &trans  &trans  &trans  &trans                                                  &trans  &trans   &trans    &trans  &trans  &trans
 &trans  &kp B   &ak_xp  &trans  &ak_lg  &trans                                                  &trans  &trans   &trans    &trans  &trans  &trans
 &trans  &trans  &trans  &trans  &trans  &trans                                                  &trans  &trans   &trans    &trans  &kp SQT &trans
 &trans  &trans  &trans  &trans  &trans  &trans  &trans  &trans  &trans  &trans  &trans  &trans  &trans  &trans   &trans    &trans  &trans  &trans
 &trans  &trans  &trans  &trans  &trans          &trans  &trans  &trans  &trans  &trans  &trans          &trans   &trans    &trans  &trans  &trans
            >;
        };

        l_akX {
            bindings = <
 &trans  &trans  &trans  &trans  &trans                                                                  &trans   &trans    &trans  &trans  &trans
 &trans  &trans  &trans  &trans  &trans  &trans                                                  &trans  &trans   &trans    &trans  &trans  &trans
 &trans  &trans  &ak_xp  &kp L   &trans  &trans                                                  &trans  &trans   &trans    &trans  &trans  &trans
 &trans  &trans  &trans  &trans  &trans  &trans                                                  &trans  &trans   &trans    &trans  &trans  &trans
 &trans  &trans  &trans  &trans  &trans  &trans  &trans  &trans  &trans  &trans  &trans  &trans  &trans  &trans   &trans    &trans  &trans  &trans
 &trans  &trans  &trans  &trans  &trans          &trans  &trans  &trans  &trans  &trans  &trans          &trans   &trans    &trans  &trans  &trans
            >;
        };

        l_akT {
            bindings = <
 &trans  &trans  &trans  &trans  &trans                                                                  &trans   &trans    &trans  &trans  &trans
 &trans  &trans  &trans  &trans  &trans  &trans                                                  &trans  &trans   &trans    &trans  &trans  &trans
 &trans  &trans  &trans  &trans  &trans  &trans                                                  &trans  &trans   &trans    &trans  &trans  &trans
 &trans  &trans  &Ch     &trans  &trans  &ak_ck                                                  &trans  &trans   &trans    &trans  &trans  &trans
 &trans  &trans  &trans  &trans  &trans  &trans  &trans  &trans  &trans  &trans  &trans  &trans  &trans  &trans   &trans    &trans  &trans  &trans
 &trans  &trans  &trans  &trans  &trans          &trans  &trans  &trans  &trans  &trans  &trans          &trans   &trans    &trans  &trans  &trans
            >;
        };

        l_akC {
            bindings = <
 &trans  &trans  &trans  &trans  &trans                                                                  &trans   &trans    &trans  &trans  &trans
 &trans  &trans  &trans  &trans  &trans  &trans                                                  &trans  &trans   &trans    &trans  &trans  &trans
 &trans  &trans  &trans  &trans  &trans  &trans                                                  &trans  &trans   &trans    &trans  &trans  &trans
 &trans  &trans  &trans  &trans  &trans  &trans                                                  &trans  &trans   &trans    &trans  &trans  &trans
 &trans  &ak_sb  &trans  &trans  &trans  &trans  &trans  &trans  &trans  &trans  &trans  &trans  &trans  &trans   &trans    &trans  &trans  &trans
 &trans  &trans  &trans  &trans  &trans          &trans  &trans  &trans  &trans  &trans  &trans          &trans   &trans    &trans  &trans  &trans
            >;
        };

        l_akK {
            bindings = <
 &trans  &trans  &trans  &trans  &trans                                                                  &trans   &trans    &trans  &trans  &trans
 &trans  &trans  &trans  &trans  &trans  &trans                                                  &trans  &trans   &trans    &trans  &trans  &trans
 &trans  &trans  &trans  &trans  &kp L   &trans                                                  &trans  &trans   &trans    &trans  &trans  &trans
 &trans  &trans  &trans  &trans  &kp N   &trans                                                  &trans  &trans   &trans    &trans  &trans  &trans
 &trans  &trans  &trans  &trans  &trans  &trans  &trans  &trans  &trans  &trans  &trans  &trans  &trans  &trans   &trans    &trans  &trans  &trans
 &trans  &trans  &trans  &trans  &trans          &trans  &trans  &trans  &trans  &trans  &trans          &trans   &trans    &trans  &trans  &trans
            >;
        };

        l_akD {
            bindings = <
 &trans  &trans  &trans  &trans  &trans                                                                  &trans   &trans    &trans  &trans  &trans
 &trans  &trans  &trans  &trans  &trans  &trans                                                  &trans  &trans   &trans    &trans  &trans  &trans
 &trans  &trans  &trans  &trans  &trans  &trans                                                  &trans  &trans   &trans    &trans  &trans  &trans
 &trans  &trans  &trans  &trans  &trans  &trans                                                  &trans  &trans   &trans    &trans  &trans  &trans
 &trans  &kp V   &kp G   &trans  &trans  &trans  &trans  &trans  &trans  &trans  &trans  &trans  &trans  &trans   &trans    &trans  &trans  &trans
 &trans  &trans  &trans  &trans  &trans          &trans  &trans  &trans  &trans  &trans  &trans          &trans   &trans    &trans  &trans  &trans
            >;
        };

        l_akW {
            bindings = <
 &trans  &trans  &trans  &trans  &trans                                                                  &trans   &trans    &trans  &trans  &trans
 &trans  &trans  &trans  &trans  &trans  &trans                                                  &trans  &trans   &trans    &trans  &trans  &trans
 &trans  &kp S   &trans  &ak_lm  &trans  &trans                                                  &trans  &trans   &trans    &trans  &trans  &trans
 &trans  &trans  &trans  &trans  &trans  &trans                                                  &trans  &trans   &trans    &trans  &trans  &trans
 &trans  &trans  &trans  &trans  &trans  &trans  &trans  &trans  &trans  &trans  &trans  &trans  &trans  &trans   &trans    &trans  &trans  &trans
 &trans  &trans  &trans  &trans  &trans          &trans  &trans  &trans  &trans  &trans  &trans          &trans   &trans    &trans  &trans  &trans
            >;
        };

        l_akF {
            bindings = <
 &trans  &trans  &trans  &trans  &trans                                                                  &trans   &trans    &trans  &trans  &trans
 &trans  &trans  &trans  &trans  &trans  &trans                                                  &trans  &trans   &trans    &trans  &trans  &trans
 &trans  &trans  &trans  &trans  &trans  &trans                                                  &trans  &trans   &trans    &trans  &trans  &trans
 &trans  &trans  &trans  &trans  &trans  &trans                                                  &trans  &trans   &trans    &trans  &trans  &trans
 &trans  &trans  &trans  &trans  &trans  &trans  &trans  &trans  &trans  &trans  &trans  &trans  &trans  &trans   &trans    &trans  &trans  &trans
 &trans  &trans  &trans  &trans  &trans          &trans  &trans  &trans  &trans  &trans  &trans          &trans   &trans    &trans  &trans  &trans
            >;
        };

        l_akP {
            bindings = <
 &trans  &trans  &trans  &trans  &trans                                                                  &trans   &trans    &trans  &trans  &trans
 &trans  &trans  &trans  &trans  &trans  &trans                                                  &trans  &trans   &trans    &trans  &trans  &trans
 &trans  &trans  &trans  &trans  &trans  &trans                                                  &trans  &trans   &trans    &trans  &trans  &trans
 &trans  &trans  &trans  &trans  &trans  &trans                                                  &trans  &trans   &trans    &trans  &trans  &trans
 &trans  &ak_sb  &trans  &trans  &trans  &trans  &trans  &trans  &trans  &trans  &trans  &trans  &trans  &trans   &trans    &trans  &trans  &trans
 &trans  &trans  &trans  &trans  &trans          &trans  &trans  &trans  &trans  &trans  &trans          &trans   &trans    &trans  &trans  &trans
            >;
        };

        l_akB {
            bindings = <
 &trans  &trans  &trans  &trans  &trans                                                                  &trans   &trans    &trans  &trans  &trans
 &trans  &trans  &trans  &trans  &trans  &trans                                                  &trans  &trans   &trans    &trans  &trans  &trans
 &trans  &trans  &trans  &trans  &trans  &trans                                                  &trans  &trans   &trans    &trans  &trans  &trans
 &trans  &trans  &kp S   &trans  &trans  &trans                                                  &trans  &trans   &trans    &trans  &trans  &trans
 &trans  &trans  &ak_sp  &trans  &trans  &trans  &trans  &trans  &trans  &trans  &trans  &trans  &trans  &trans   &trans    &trans  &trans  &trans
 &trans  &trans  &trans  &trans  &trans          &trans  &trans  &trans  &trans  &trans  &trans          &trans   &trans    &trans  &trans  &trans
            >;
        };

        l_akV {
            bindings = <
 &trans  &trans  &trans  &trans  &trans                                                                  &trans   &trans    &trans  &trans  &trans
 &trans  &trans  &trans  &trans  &trans  &trans                                                  &trans  &trans   &trans    &trans  &trans  &trans
 &trans  &trans  &trans  &trans  &trans  &trans                                                  &trans  &trans   &trans    &trans  &trans  &trans
 &trans  &trans  &trans  &trans  &trans  &trans                                                  &trans  &trans   &trans    &trans  &trans  &trans
 &trans  &trans  &ak_sf  &trans  &trans  &trans  &trans  &trans  &trans  &trans  &trans  &trans  &trans  &trans   &trans    &trans  &trans  &trans
 &trans  &trans  &trans  &trans  &trans          &trans  &trans  &trans  &trans  &trans  &trans          &trans   &trans    &trans  &trans  &trans
            >;
        };

        l_akJ {
            bindings = <
 &trans  &trans  &trans  &trans  &trans                                                                  &trans   &trans    &trans  &trans  &trans
 &trans  &trans  &trans  &trans  &trans  &trans                                                  &trans  &trans   &trans    &trans  &trans  &trans
 &trans  &trans  &trans  &trans  &l_j_g  &trans                                                  &trans  &trans   &trans    &trans  &trans  &trans
 &trans  &trans  &trans  &trans  &trans  &trans                                                  &trans  &trans   &trans    &trans  &kp SQT &trans
 &trans  &trans  &trans  &trans  &trans  &trans  &trans  &trans  &trans  &trans  &trans  &trans  &trans  &trans   &trans    &trans  &kp I   &trans
 &trans  &trans  &trans  &trans  &trans          &trans  &trans  &trans  &trans  &trans  &trans          &trans   &trans    &trans  &trans  &trans
            >;
        };

        l_akA {
            bindings = <
 &trans  &trans  &trans  &trans  &trans                                                                  &trans   &trans    &trans  &trans  &trans
 &trans  &trans  &trans  &trans  &trans  &trans                                                  &trans  &trans   &trans    &trans  &trans  &trans
 &trans  &trans  &trans  &trans  &trans  &trans                                                  &trans  &trans   &trans    &trans  &trans  &trans
 &trans  &trans  &trans  &trans  &trans  &trans                                                  &trans  &trans   &trans    &trans  &kp U   &trans
 &trans  &trans  &trans  &trans  &trans  &trans  &trans  &trans  &trans  &trans  &trans  &trans  &trans  &trans   &trans    &trans  &trans  &trans
 &trans  &trans  &trans  &trans  &trans          &trans  &trans  &trans  &trans  &trans  &trans          &trans   &trans    &trans  &trans  &trans
            >;
        };

        l_akU {
            bindings = <
 &trans  &trans  &trans  &trans  &trans                                                                  &trans   &trans    &trans  &trans  &trans
 &trans  &trans  &trans  &trans  &trans  &trans                                                  &trans  &trans   &trans    &trans  &trans  &trans
 &trans  &trans  &trans  &trans  &trans  &trans                                                  &trans  &trans   &trans    &trans  &trans  &trans
 &trans  &trans  &trans  &trans  &trans  &trans                                                  &trans  &trans   &trans    &trans  &kp A   &trans
 &trans  &trans  &trans  &trans  &trans  &trans  &trans  &trans  &trans  &trans  &trans  &trans  &trans  &trans   &trans    &trans  &trans  &trans
 &trans  &trans  &trans  &trans  &trans          &trans  &trans  &trans  &trans  &trans  &trans          &trans   &trans    &trans  &trans  &trans
            >;
        };

        l_akE {
            bindings = <
 &trans  &trans  &trans  &trans  &trans                                                                  &trans   &trans    &trans  &trans  &trans
 &trans  &trans  &trans  &trans  &trans  &trans                                                  &trans  &trans   &trans    &trans  &trans  &trans
 &trans  &trans  &trans  &trans  &trans  &trans                                                  &trans  &trans   &trans    &trans  &trans  &trans
 &trans  &trans  &trans  &trans  &trans  &trans                                                  &trans  &trans   &trans    &trans  &kp O   &trans
 &trans  &trans  &trans  &trans  &trans  &trans  &trans  &trans  &trans  &trans  &trans  &trans  &trans  &trans   &trans    &trans  &trans  &trans
 &trans  &trans  &trans  &trans  &trans          &trans  &trans  &trans  &trans  &trans  &trans          &trans   &trans    &trans  &trans  &trans
            >;
        };

        l_akO {
            bindings = <
 &trans  &trans  &trans  &trans  &trans                                                                  &trans   &trans    &trans  &trans  &trans
 &trans  &trans  &trans  &trans  &trans  &trans                                                  &trans  &trans   &trans    &trans  &trans  &trans
 &trans  &trans  &trans  &trans  &trans  &trans                                                  &trans  &trans   &trans    &trans  &trans  &trans
 &trans  &trans  &trans  &trans  &trans  &trans                                                  &trans  &trans   &trans    &trans  &kp E   &trans
 &trans  &trans  &trans  &trans  &trans  &trans  &trans  &trans  &trans  &trans  &trans  &trans  &trans  &trans   &trans    &trans  &trans  &trans
 &trans  &trans  &trans  &trans  &trans          &trans  &trans  &trans  &trans  &trans  &trans          &trans   &trans    &trans  &trans  &trans
            >;
        };

        l_akI {
            bindings = <
 &trans  &trans  &trans  &trans  &trans                                                                  &trans   &trans    &trans  &trans  &trans
 &trans  &trans  &trans  &trans  &trans  &trans                                                  &trans  &trans   &trans    &trans  &trans  &trans
 &trans  &trans  &trans  &trans  &trans  &trans                                                  &trans  &trans   &trans    &trans  &trans  &trans
 &trans  &trans  &trans  &trans  &trans  &trans                                                  &trans  &trans   &trans    &trans  &kp F   &trans
 &trans  &trans  &trans  &trans  &trans  &trans  &trans  &trans  &trans  &trans  &trans  &trans  &trans  &trans   &trans    &trans  &trans  &trans
 &trans  &trans  &trans  &trans  &trans          &trans  &trans  &trans  &trans  &trans  &trans          &trans   &trans    &trans  &trans  &trans
            >;
        };

        l_akDot {
            bindings = <
 &trans  &trans  &trans  &trans  &trans                                                                  &trans   &trans    &trans  &trans  &trans
 &trans  &trans  &trans  &trans  &trans  &trans                                                  &trans  &trans   &trans    &trans  &trans  &trans
 &trans  &trans  &trans  &trans  &trans  &trans                                                  &trans  &trans  &dotcom  &dotcouk  &trans  &trans
 &trans  &trans  &trans  &trans  &trans  &trans                                                  &trans  &trans   &trans    &trans  &trans  &trans
 &trans  &trans  &trans  &trans  &trans  &trans  &trans  &trans  &trans  &trans  &trans  &trans  &trans  &trans   &trans    &trans  &trans  &trans
 &trans  &trans  &trans  &trans  &trans          &trans  &trans  &trans  &trans  &trans  &trans          &trans   &trans    &trans  &trans  &trans
            >;
        };

    };
};
